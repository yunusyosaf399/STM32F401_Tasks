# file: GPIO_Register_Level_Setup.ioc
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Mcu.Family=STM32F4
Mcu.Name=STM32F401C(B-C)Ux
Mcu.Package=UFQFPN48
NVIC.PriorityGroup=NVIC_PRIORITYGROUP_4
NVIC.RCC_IRQn=true\:0\:0\:false\:false\:true\:true\:false\:true
PH0\ -\ OSC_IN.Mode=HSE-External-Oscillator
PH0\ -\ OSC_IN.Signal=RCC_OSC_IN
PH1\ -\ OSC_OUT.Mode=HSE-External-Oscillator
PH1\ -\ OSC_OUT.Signal=RCC_OSC_OUT
ProjectManager.HeapSize=0x200
ProjectManager.StackSize=0x400
ProjectManager.TargetToolchain=STM32CubeIDE
RCC.48MHZClocksFreq_Value=42000000
RCC.AHBFreq_Value=16000000
RCC.APB1CLKDivider=RCC_HCLK_DIV2
RCC.APB1Freq_Value=8000000
RCC.APB1TimFreq_Value=16000000
RCC.APB2Freq_Value=16000000
RCC.APB2TimFreq_Value=16000000
RCC.CortexFreq_Value=16000000
RCC.HCLKFreq_Value=16000000
RCC.HSE_VALUE=25000000
RCC.HSI_VALUE=16000000
RCC.LSE_VALUE=32768
RCC.PLLM=8
RCC.PLLN=84
RCC.SYSCLKFreq_VALUE=16000000
RCC.VCOOutputFreq_Value=168000000
board=custom

// file: Core/Src/main.c
/* USER CODE BEGIN Header */

/* USER CODE END Header */
#include "main.h"

void GPIOB_Setup(void) {
    // Enable GPIOB clock
    RCC->AHB1ENR |= (1U << 1);  // Bit 1 enables GPIOB clock

    // Set PB0 as output mode (MODER register)
    GPIOB->MODER &= ~(3U << (0 * 2)); // Clear bits (0 * 2)
    GPIOB->MODER |= (1U << (0 * 2));  // Set bits to 01 (Output mode)

    // Set PB0 speed to high-speed (OSPEEDR register)
    GPIOB->OSPEEDR &= ~(3U << (0 * 2)); // Clear speed bits
    GPIOB->OSPEEDR |= (2U << (0 * 2));  // Set bits to 10 (High speed)
}

/* USER CODE END PV */

void SystemClock_Config(void);
static void MX_GPIO_Init(void);
/* USER CODE BEGIN PFP */
void Timer2_Delay_ms(uint32_t delay) {
    // Enable TIM2 clock
    RCC->APB1ENR |= (1U << 0);  // Bit 0 enables TIM2 clock

    // Configure TIM2: Set Prescaler and Auto-Reload Value
    TIM2->PSC = 16000 - 1;  // Prescaler: 16MHz / 16000 = 1 kHz (1 ms tick)
    TIM2->ARR = delay;      // Auto-reload: delay in milliseconds

    // Reset the counter and enable TIM2
    TIM2->CNT = 0;       // Reset counter
    TIM2->CR1 |= (1U << 0);  // Enable timer

    // Wait until the update flag (UIF) is set
    while (!(TIM2->SR & (1U << 0)));

    // Clear UIF flag
    TIM2->SR &= ~(1U << 0);

    // Disable Timer (Optional: for one-shot delay)
    TIM2->CR1 &= ~(1U << 0);
}

void GPIOB_Toggle(void) {
    GPIOB->ODR ^= (1U << 0);  // Toggle PB0
}
/* USER CODE END PFP */

int main(void)
{

  /* MCU Configuration--------------------------------------------------------*/

  /* Reset of all peripherals, Initializes the Flash interface and the Systick. */
  HAL_Init();

  /* Configure the system clock */
  SystemClock_Config();

  /* Initialize all configured peripherals */
  MX_GPIO_Init();
  // Enable GPIOA clock
     RCC->AHB1ENR |= (1U << 0);

     // Set PA5 as Output
     GPIOA->MODER &= ~(3U << (5 * 2));  // Clear bits
     GPIOA->MODER |= (1U << (5 * 2));   // Set as Output

     while (1) {
         GPIOA->ODR ^= (1U << 5);  // Toggle PA5
         Timer2_Delay_ms(1000);     // 1-second delay
     }
}

void SystemClock_Config(void)
{
  RCC_OscInitTypeDef RCC_OscInitStruct = {0};
  RCC_ClkInitTypeDef RCC_ClkInitStruct = {0};

  /** Configure the main internal regulator output voltage
  */
  __HAL_RCC_PWR_CLK_ENABLE();
  __HAL_PWR_VOLTAGESCALING_CONFIG(PWR_REGULATOR_VOLTAGE_SCALE2);

  /** Initializes the RCC Oscillators according to the specified parameters
  * in the RCC_OscInitTypeDef structure.
  */
  RCC_OscInitStruct.OscillatorType = RCC_OSCILLATORTYPE_HSI;
  RCC_OscInitStruct.HSIState = RCC_HSI_ON;
  RCC_OscInitStruct.HSICalibrationValue = RCC_HSICALIBRATION_DEFAULT;
  RCC_OscInitStruct.PLL.PLLState = RCC_PLL_NONE;
  if (HAL_RCC_OscConfig(&RCC_OscInitStruct) != HAL_OK)
  {
    Error_Handler();
  }

  /** Initializes the CPU, AHB and APB buses clocks
  */
  RCC_ClkInitStruct.ClockType = RCC_CLOCKTYPE_HCLK|RCC_CLOCKTYPE_SYSCLK
                              |RCC_CLOCKTYPE_PCLK1|RCC_CLOCKTYPE_PCLK2;
  RCC_ClkInitStruct.SYSCLKSource = RCC_SYSCLKSOURCE_HSI;
  RCC_ClkInitStruct.AHBCLKDivider = RCC_SYSCLK_DIV1;
  RCC_ClkInitStruct.APB1CLKDivider = RCC_HCLK_DIV2;
  RCC_ClkInitStruct.APB2CLKDivider = RCC_HCLK_DIV1;

  if (HAL_RCC_ClockConfig(&RCC_ClkInitStruct, FLASH_LATENCY_0) != HAL_OK)
  {
    Error_Handler();
  }
}

static void MX_GPIO_Init(void)
{

  /* GPIO Ports Clock Enable */
  __HAL_RCC_GPIOH_CLK_ENABLE();

}

void Error_Handler(void)
{
  __disable_irq();
  while (1)
  {
  }
}
